## build_scripts/buildroot/Config.in
```kconfig
source "$BR2_EXTERNAL_AD5M_PATH/package/ustreamer/Config.in"
source "$BR2_EXTERNAL_AD5M_PATH/package/guppyscreen/Config.in"
source "$BR2_EXTERNAL_AD5M_PATH/package/klipper-flasher/Config.in"
source "$BR2_EXTERNAL_AD5M_PATH/package/libdom/Config.in"
source "$BR2_EXTERNAL_AD5M_PATH/package/libhubbub/Config.in"
source "$BR2_EXTERNAL_AD5M_PATH/package/libparserutils/Config.in"
source "$BR2_EXTERNAL_AD5M_PATH/package/libwapcaplet/Config.in"
source "$BR2_EXTERNAL_AD5M_PATH/package/libsvgtiny/Config.in"
source "$BR2_EXTERNAL_AD5M_PATH/package/libsvgtiny-pixbuf/Config.in"
```

## build_scripts/buildroot/package/klipper-flasher/Config.in
```kconfig
config BR2_PACKAGE_KLIPPER_FLASHER
	bool "klipper_flasher"
    select BR2_PACKAGE_LIBUSB
	help
	  Build and install klipper flasher

	  https://github.com/Klipper3d/klipper
```
